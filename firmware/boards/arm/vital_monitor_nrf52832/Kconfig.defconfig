## firmware/boards/arm/vital_monitor_nrf52832/Kconfig.defconfig
```kconfig
# VITAL_MONITOR_NRF52832 board configuration

# Copyright (c) 2016 Nordic Semiconductor ASA
# SPDX-License-Identifier: Apache-2.0

if BOARD_VITAL_MONITOR_NRF52832

config BOARD
	default "vital monitor nrf52832"

config BT_CTLR
	default BT

endif # BOARD_NRF52DK_NRF52832
```

## firmware/cmake-build-zdebug/Kconfig/Kconfig.shield
```kconfig
osource "/Users/ben/Education/University/Year4/Project/Firmware/boards/shields/*/Kconfig.shield"
osource "/opt/nordic/ncs/v2.1.0/nrf/boards/shields/*/Kconfig.shield"
```

## firmware/cmake-build-zdebug/Kconfig/Kconfig.shield.defconfig
```kconfig
osource "/Users/ben/Education/University/Year4/Project/Firmware/boards/shields/*/Kconfig.defconfig"
osource "/opt/nordic/ncs/v2.1.0/nrf/boards/shields/*/Kconfig.defconfig"
```

## firmware/dts/bindings/ad469x,custom-settings.yaml
```yaml
compatible: "ad469x,custom-settings"
description: "AD469X custom settings"
properties:
  spi-frequency-reg:
    type: int
    required: true
  spi-frequency-cnv:
    type: int
    required: true
  cs-delay:
    type: int
    required: true
  adc-reset-gpios:
    type: phandle-array
    required: false
  adc-busy-gpios:
    type: phandle-array
    required: false
  adc-convert-gpios:
    type: phandle-array
    required: false
```

## firmware/dts/bindings/ad469x-sequencer,settings.yaml
```yaml
compatible: "ad469x-sequencer,settings"
description: "AD469X sequencer settings"
properties:
  adc-channels:
    type: array
    required: false
  adv-sequencer-slots:
    type: array
    required: false
```

## firmware/dts/bindings/afe-settings,custom-settings.yaml
```yaml
compatible: "afe-settings,custom-settings"
description: "AFE Settings"
properties:
  afe-enable-gpios:
    type: phandle-array
    required: false
  output-enable-gpios:
    type: phandle-array
    required: false
```

## firmware/dts/bindings/afl240320a0_binding.yaml
```yaml
compatible: "afl240320a0,custom-settings"

description: "AFL240320A0 custom settings"

properties:
  spi-frequency:
    type: int
    required: true
  blk-gpios:
    type: phandle-array
    required: false
  wake-gpios:
    type: phandle-array
    required: false
  enable-gpios:
    type: phandle-array
    required: false
  pwms:
    type: phandle-array
    required: false
  pwm-names:
    type: string
    required: false
```

## firmware/dts/bindings/lc709204f,custom-settings.yaml
```yaml
compatible: "lc709204f,custom-settings"
description: "lc709204f custom-settings"
properties:
  i2c-frequency:
    type: int
    required: true
  slave-address:
    type: int
    required: false

#  alarm-b-gpios:
#    type: phandle-array
#    required: true
```

## firmware/dts/bindings/vital-monitor,bluetooth-settings.yaml
```yaml
compatible: "vital-monitor,bluetooth-settings"
description: "BLE settings"
properties:
  adv-name:
    type: string
    required: true
```
